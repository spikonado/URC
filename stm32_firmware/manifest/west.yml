## stm32_firmware/manifest/west.yml
```yaml
manifest:
  remotes:
    - name: zephyrproject
      url-base: https://github.com/zephyrproject-rtos

  projects:
    - name: zephyr
      remote: zephyrproject
      revision: v4.4.1
      import:
        name-allowlist:
          - cmsis
          - cmsis_6
          - hal_stm32
```
